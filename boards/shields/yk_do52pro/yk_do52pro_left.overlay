/*
 * Copyright (c) 2020 Pete Johanson
 *
 * SPDX-License-Identifier: MIT
 */

#include "yk_do52pro.dtsi"

&kscan0 {
    col-gpios
        = <&pro_micro 1 GPIO_ACTIVE_HIGH> // P0.06
        , <&pro_micro 0 GPIO_ACTIVE_HIGH> // P0.08
        , <&pro_micro 2 GPIO_ACTIVE_HIGH> // P0.17
        , <&pro_micro 4 GPIO_ACTIVE_HIGH> // P0.22
        , <&pro_micro 5 GPIO_ACTIVE_HIGH> // P0.24
        , <&pro_micro 6 GPIO_ACTIVE_HIGH> // P1.00
        ;
};
